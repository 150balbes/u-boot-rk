## arch/arm/mach-rockchip/rk3568/Kconfig
```kconfig
if ROCKCHIP_RK3568

config TARGET_EVB_RK3568
	bool "RK3568 evaluation board"
	select BOARD_LATE_INIT
	help
	  RK3568 EVB is a evaluation board for Rockchp RK3568.

config TARGET_ROC_PC_RK3566
	bool "Firefly Station M2 RK3566"
	help
	  Station M2 RK3566 is a development board from Firefly
	  on the Rockchip RK3566 SoC.

config TARGET_PINENOTE_RK3566
	bool "Pinenote RK3566 E-Ink Linux Tablet"
	help
	  Pinenote RK3566 is a E-Ink tablet from Pine64
	  on the Rockchip RK3566 SoC.

config TARGET_QUARTZ64_A_RK3566
	bool "PINE64 Quartz64 Model A"
	help
	  The PINE64 Quartz64 Model A is a single board computer based
	  on the Rockchip RK3566 SoC.

config TARGET_QUARTZ64_B_RK3566
	bool "PINE64 Quartz64 Model B"
	help
	  The PINE64 Quartz64 Model B is a single board computer based
	  on the Rockchip RK3566 SoC.

config TARGET_SOQUARTZ_BLADE_RK3566
	bool "PINE64 SOQuartz in Blade carrier board"
	select BOARD_LATE_INIT
	help
	  The PINE64 SOQuartz Blade board is a carrier board for the
	  PINE64 SOQuartz CM4 compute module.

config TARGET_SOQUARTZ_CM4IO_RK3566
	bool "PINE64 SOQuartz in CM4IO carrier board"
	select BOARD_LATE_INIT
	help
	  The SOQuartz Module but placed in a Raspberry Pi CM4 IO
	  carrier board.

config TARGET_SOQUARTZ_MODEL_A_RK3566
	bool "PINE64 SOQuartz in Model A carrier board"
	select BOARD_LATE_INIT
	help
	  The PINE64 SOQuartz Model A board is a carrier board for the
	  PINE64 SOQuartz CM4 compute module.

config ROCKCHIP_BOOT_MODE_REG
	default 0xfdc20200

config ROCKCHIP_STIMER_BASE
	default 0xfdd1c020

config SYS_SOC
	default "rk3568"

config SYS_MALLOC_F_LEN
	default 0x2000

source "board/rockchip/evb_rk3568/Kconfig"
source "board/firefly/roc-pc-rk3566/Kconfig"
source "board/pine64/pinenote-rk3566/Kconfig"
source "board/pine64/quartz64-a-rk3566/Kconfig"
source "board/pine64/quartz64-b-rk3566/Kconfig"
source "board/pine64/soquartz-blade-rk3566/Kconfig"
source "board/pine64/soquartz-cm4io-rk3566/Kconfig"
source "board/pine64/soquartz-model-a-rk3566/Kconfig"

endif
```

## board/firefly/roc-pc-rk3566/Kconfig
```kconfig
if TARGET_FIREFLY_M2_RK3566

config SYS_BOARD
	default "firefly-m2-rk3566"

config SYS_VENDOR
	default "firefly"

config SYS_CONFIG_NAME
	default "firefly-m2-rk3566"

config BOARD_SPECIFIC_OPTIONS # dummy
	def_bool y

endif
```

## board/pine64/pinenote-rk3566/Kconfig
```kconfig
if TARGET_PINENOTE_RK3566

config SYS_BOARD
	default "pinenote-rk3566"

config SYS_VENDOR
	default "pine64"

config SYS_CONFIG_NAME
	default "pinenote-rk3566"

config BOARD_SPECIFIC_OPTIONS # dummy
	def_bool y

endif
```

## board/pine64/quartz64-a-rk3566/Kconfig
```kconfig
if TARGET_QUARTZ64_A_RK3566

config SYS_BOARD
	default "quartz64-a-rk3566"

config SYS_VENDOR
	default "pine64"

config SYS_CONFIG_NAME
	default "quartz64-a-rk3566"

config BOARD_SPECIFIC_OPTIONS # dummy
	def_bool y

endif
```

## board/pine64/quartz64-b-rk3566/Kconfig
```kconfig
if TARGET_QUARTZ64_B_RK3566

config SYS_BOARD
	default "quartz64-b-rk3566"

config SYS_VENDOR
	default "pine64"

config SYS_CONFIG_NAME
	default "quartz64-b-rk3566"

config BOARD_SPECIFIC_OPTIONS # dummy
	def_bool y

endif
```

## board/pine64/soquartz-blade-rk3566/Kconfig
```kconfig
if TARGET_SOQUARTZ_BLADE_RK3566

config SYS_BOARD
	default "soquartz-blade-rk3566"

config SYS_VENDOR
	default "pine64"

config SYS_CONFIG_NAME
	default "soquartz-blade-rk3566"

config BOARD_SPECIFIC_OPTIONS # dummy
	def_bool y

endif
```

## board/pine64/soquartz-cm4io-rk3566/Kconfig
```kconfig
if TARGET_SOQUARTZ_CM4IO_RK3566

config SYS_BOARD
	default "soquartz-cm4io-rk3566"

config SYS_VENDOR
	default "pine64"

config SYS_CONFIG_NAME
	default "soquartz-cm4io-rk3566"

config BOARD_SPECIFIC_OPTIONS # dummy
	def_bool y

endif
```

## board/pine64/soquartz-model-a-rk3566/Kconfig
```kconfig
if TARGET_SOQUARTZ_MODEL_A_RK3566

config SYS_BOARD
	default "soquartz-model-a-rk3566"

config SYS_VENDOR
	default "pine64"

config SYS_CONFIG_NAME
	default "soquartz-model-a-rk3566"

config BOARD_SPECIFIC_OPTIONS # dummy
	def_bool y

endif
```

## board/rockchip/tinker-2_rk3399/Kconfig
```kconfig
if TARGET_TINKER-2_RK3399

config SYS_BOARD
	default "tinker-2_rk3399"

config SYS_VENDOR
	default "rockchip"

config SYS_CONFIG_NAME
	default "tinker-2_rk3399"

config BOARD_SPECIFIC_OPTIONS # dummy
	def_bool y

endif
```

## configs/quartz64-b-rk3566_defconfig
```kconfig
CONFIG_ARM=y
CONFIG_SKIP_LOWLEVEL_INIT=y
CONFIG_ARCH_ROCKCHIP=y
CONFIG_SYS_TEXT_BASE=0x00a00000
CONFIG_SPL_LIBCOMMON_SUPPORT=y
CONFIG_SPL_LIBGENERIC_SUPPORT=y
CONFIG_NR_DRAM_BANKS=2
CONFIG_DEFAULT_DEVICE_TREE="rk3566-quartz64-b"
CONFIG_ROCKCHIP_RK3568=y
CONFIG_SPL_ROCKCHIP_BACK_TO_BROM=y
CONFIG_SPL_ROCKCHIP_COMMON_BOARD=y
CONFIG_SPL_MMC=y
CONFIG_SPL_SERIAL=y
CONFIG_SPL_STACK_R_ADDR=0x600000
CONFIG_TARGET_QUARTZ64_B_RK3566=y
CONFIG_DEBUG_UART_BASE=0xFE660000
CONFIG_DEBUG_UART_CLOCK=24000000
CONFIG_SPL_SPI_FLASH_SUPPORT=y
CONFIG_SPL_SPI=y
CONFIG_DEBUG_UART=y
CONFIG_SYS_LOAD_ADDR=0xc00800
CONFIG_API=y
CONFIG_FIT=y
CONFIG_FIT_VERBOSE=y
CONFIG_SPL_LOAD_FIT=y
CONFIG_OF_SYSTEM_SETUP=y
CONFIG_DEFAULT_FDT_FILE="rockchip/rk3566-quartz64-b.dtb"
# CONFIG_SYS_DEVICE_NULLDEV is not set
# CONFIG_DISPLAY_CPUINFO is not set
CONFIG_DISPLAY_BOARDINFO_LATE=y
CONFIG_SPL_BOARD_INIT=y
# CONFIG_SPL_RAW_IMAGE_SUPPORT is not set
CONFIG_SPL_STACK_R=y
CONFIG_SPL_SEPARATE_BSS=y
CONFIG_SPL_ADC=y
# CONFIG_SPL_SPI_FLASH_TINY is not set
CONFIG_SPL_SPI_FLASH_SFDP_SUPPORT=y
CONFIG_SPL_SPI_LOAD=y
CONFIG_SYS_SPI_U_BOOT_OFFS=0x40000
CONFIG_SPL_ATF=y
CONFIG_CMD_ADC=y
CONFIG_CMD_BIND=y
CONFIG_CMD_CLK=y
CONFIG_CMD_GPIO=y
CONFIG_CMD_GPT=y
CONFIG_CMD_I2C=y
CONFIG_CMD_MMC=y
CONFIG_CMD_USB=y
CONFIG_CMD_USB_SDP=y
CONFIG_CMD_ROCKUSB=y
CONFIG_CMD_USB_MASS_STORAGE=y
# CONFIG_CMD_SETEXPR is not set
CONFIG_CMD_PMIC=y
CONFIG_CMD_REGULATOR=y
# CONFIG_SPL_DOS_PARTITION is not set
CONFIG_SPL_OF_CONTROL=y
CONFIG_OF_LIVE=y
CONFIG_OF_SPL_REMOVE_PROPS="pinctrl-0 pinctrl-names clock-names interrupt-parent assigned-clocks assigned-clock-rates assigned-clock-parents"
CONFIG_NET_RANDOM_ETHADDR=y
CONFIG_SPL_DM_WARN=y
CONFIG_SPL_REGMAP=y
CONFIG_SPL_SYSCON=y
CONFIG_SPL_CLK=y
CONFIG_FASTBOOT_BUF_ADDR=0x800800
CONFIG_SPL_FIRMWARE=y
CONFIG_ROCKCHIP_GPIO=y
CONFIG_ROCKCHIP_GPIO_V2=y
CONFIG_SYS_I2C_ROCKCHIP=y
CONFIG_MISC=y
CONFIG_MMC_IO_VOLTAGE=y
CONFIG_SPL_MMC_IO_VOLTAGE=y
CONFIG_MMC_UHS_SUPPORT=y
CONFIG_SPL_MMC_UHS_SUPPORT=y
CONFIG_MMC_HS200_SUPPORT=y
CONFIG_SPL_MMC_HS200_SUPPORT=y
CONFIG_MMC_DW=y
CONFIG_MMC_DW_ROCKCHIP=y
CONFIG_MMC_SDHCI=y
CONFIG_MMC_SDHCI_SDMA=y
CONFIG_MMC_SDHCI_ROCKCHIP=y
CONFIG_SPI_FLASH_ATMEL=y
CONFIG_SPI_FLASH_EON=y
CONFIG_SPI_FLASH_GIGADEVICE=y
CONFIG_SPI_FLASH_ISSI=y
CONFIG_SPI_FLASH_MACRONIX=y
CONFIG_SPI_FLASH_SPANSION=y
CONFIG_SPI_FLASH_S28HS512T=y
CONFIG_SPI_FLASH_STMICRO=y
CONFIG_SPI_FLASH_MT35XU=y
CONFIG_SPI_FLASH_SST=y
CONFIG_SPI_FLASH_WINBOND=y
CONFIG_SPI_FLASH_XMC=y
CONFIG_SPI_FLASH_XTX=y
CONFIG_SPI_FLASH_DATAFLASH=y
CONFIG_DM_ETH=y
CONFIG_ETH_DESIGNWARE=y
CONFIG_GMAC_ROCKCHIP=y
CONFIG_POWER_DOMAIN=y
CONFIG_DM_PMIC=y
CONFIG_PMIC_RK8XX=y
CONFIG_SPL_PMIC_RK8XX=y
CONFIG_REGULATOR_PWM=y
CONFIG_DM_REGULATOR_FIXED=y
CONFIG_SPL_DM_REGULATOR_FIXED=y
CONFIG_DM_REGULATOR_GPIO=y
CONFIG_REGULATOR_RK8XX=y
CONFIG_PWM_ROCKCHIP=y
CONFIG_SPL_RAM=y
CONFIG_DM_RESET=y
CONFIG_BAUDRATE=1500000
CONFIG_DEBUG_UART_SHIFT=2
CONFIG_ROCKCHIP_SFC=y
CONFIG_SYSRESET=y
CONFIG_USB=y
CONFIG_USB_XHCI_HCD=y
CONFIG_USB_XHCI_DWC3=y
CONFIG_USB_EHCI_HCD=y
CONFIG_USB_EHCI_GENERIC=y
CONFIG_USB_OHCI_HCD=y
CONFIG_USB_OHCI_GENERIC=y
CONFIG_USB_DWC3=y
CONFIG_USB_DWC3_GENERIC=y
CONFIG_ROCKCHIP_USB2_PHY=y
CONFIG_USB_KEYBOARD=y
CONFIG_USB_HOST_ETHER=y
CONFIG_USB_ETHER_LAN75XX=y
CONFIG_USB_ETHER_LAN78XX=y
CONFIG_USB_ETHER_SMSC95XX=y
CONFIG_USB_GADGET=y
CONFIG_USB_FUNCTION_ROCKUSB=y
CONFIG_ERRNO_STR=y
```
